#pragma once

#include <avr/io.h>
#include <avr/interrupt.h>
#include <avr/pgmspace.h>
#include <avr/xmega.h>
#include <stdint.h>
#include <stdlib.h>

#define F_SCL 100000UL // SCL frequency
#define TW_PRE 1
//#define TWBR_val (((F_CPU / F_SCL) - 16 ) / (2*TW_PRE))
#define TWBR_val ((F_CPU / (2*F_SCL)) - 5)

volatile uint8_t twi_ptr;
volatile uint8_t twi_buf[256];

/*
ISR(TWI_vect) {
  uint8_t head = twi_ptr;
  if (head) {
    head -= 1;
    TWDR = twi_buf[head];
    twi_ptr = head;
    TWCR = (1<<TWINT) | (1<<TWEN) | (1<<TWIE);
  } else {
    twi_ptr = 0xFF;
    TWCR = (1<<TWINT) | (1<<TWSTO) | (1<<TWEN);
  }
}

inline void start_twi() {
  TWCR = 0;
  TWCR = (1<<TWINT) | (1<<TWSTA) | (1<<TWEN) | (1<<TWIE);
}

inline void init_twi() {
  TWSR = 0;
  TWBR = (uint8_t)TWBR_val;
  twi_ptr = 0xFF;
}*/

ISR(TWIE_TWIM_vect) {
  uint8_t head = twi_ptr;
  if (head) {
    head -= 1;
    TWIE_MASTER_DATA = twi_buf[head];
    twi_ptr = head;
  } else {
    twi_ptr = 0xFF;
    TWIE_MASTER_CTRLC = 0b00000011;
  }
}

inline void start_twi() {
  TWIE_MASTER_ADDR = twi_buf[--twi_ptr];
}

inline void init_twi() {
  TWIE_MASTER_BAUD = TWBR_val;
  TWIE_MASTER_CTRLA = 0b01011000;
  TWIE_MASTER_STATUS = 0b00000001;
  twi_ptr = 0xFF;
}

inline void wait_twi() {
  while(twi_ptr != 0xFF);
}

inline bool check_twi() {
  return twi_ptr == 0xFF;
}

// Constants
#define SSD1306_I2C_ADDRESS         0x3C*2    // 011110+SA0+RW - 0x3C or 0x3D
#define SSD1306_SETCONTRAST         0x81
#define SSD1306_DISPLAYALLON_RESUME 0xA4
#define SSD1306_DISPLAYALLON        0xA5
#define SSD1306_NORMALDISPLAY       0xA6
#define SSD1306_INVERTDISPLAY       0xA7
#define SSD1306_DISPLAYOFF          0xAE
#define SSD1306_DISPLAYON           0xAF
#define SSD1306_SETDISPLAYOFFSET    0xD3
#define SSD1306_SETCOMPINS          0xDA
#define SSD1306_SETVCOMDETECT       0xDB
#define SSD1306_SETDISPLAYCLOCKDIV  0xD5
#define SSD1306_SETPRECHARGE        0xD9
#define SSD1306_SETMULTIPLEX        0xA8
#define SSD1306_SETLOWCOLUMN        0x00
#define SSD1306_SETHIGHCOLUMN       0x10
#define SSD1306_SETSTARTLINE        0x40
#define SSD1306_MEMORYMODE          0x20
#define SSD1306_COLUMNADDR          0x21
#define SSD1306_PAGEADDR            0x22
#define SSD1306_COMSCANINC          0xC0
#define SSD1306_COMSCANDEC          0xC8
#define SSD1306_SEGREMAP            0xA0
#define SSD1306_CHARGEPUMP          0x8D
//#define SSD1306_EXTERNALVCC         0x01
#define SSD1306_SWITCHCAPVCC        0x02

// Scrolling constants
#define SSD1306_ACTIVATE_SCROLL                       0x2F
#define SSD1306_DEACTIVATE_SCROLL                     0x2E
#define SSD1306_SET_VERTICAL_SCROLL_AREA              0xA3
#define SSD1306_RIGHT_HORIZONTAL_SCROLL               0x26
#define SSD1306_LEFT_HORIZONTAL_SCROLL                0x27
#define SSD1306_VERTICAL_AND_RIGHT_HORIZONTAL_SCROLL  0x29
#define SSD1306_VERTICAL_AND_LEFT_HORIZONTAL_SCROLL   0x2A

#define SSD1306_PAGES  8
#define SSD1306_WIDTH  128
#define SSD1306_HEIGHT 64

// source: http://www.piclist.com/techref/datafile/charset/8x6.htm
static const uint8_t Font8x5[] PROGMEM __attribute__ ((aligned(256))) = {
0x00,0x64,0x3c,0x0c,0x3c,0x00,0x04,0x10,0x20,0x22,0x00,0x00,0x00,0x08,0x00,0x7f,
0x10,0x04,0x00,0x40,0x06,0x0f,0x00,0x44,0x14,0x51,0x00,0x00,0x08,0x7c,0x04,0x10,
0x00,0x00,0x00,0x14,0x00,0x23,0x36,0x00,0x00,0x00,0x14,0x08,0x00,0x08,0x00,0x20,
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0x10,0x55,0x12,0x04,0x38,0x18,0x00,0x00,0x00,0x00,0x00,0x00,0x00,0x00,0x00,0x00
};

inline void display_pos(uint8_t x, uint8_t y) {
  wait_twi();
  twi_buf[7] = SSD1306_I2C_ADDRESS;
  twi_buf[6] = 0;
  twi_buf[5] = SSD1306_COLUMNADDR;
  twi_buf[4] = x;
  twi_buf[3] = SSD1306_WIDTH-1;
  twi_buf[2] = SSD1306_PAGEADDR;
  twi_buf[1] = y;
  twi_buf[0] = SSD1306_PAGES-1;
  twi_ptr = 8;
  start_twi();
}

void display_clear() {
  display_pos(0,0);
  wait_twi();
  for (uint8_t i=0;i<128;++i) twi_buf[i] = 0;
  twi_buf[128] = 0x40;
  twi_buf[129] = SSD1306_I2C_ADDRESS;
  twi_ptr = 130;
  start_twi();
  for (uint8_t i=0;i<7;++i) {
    wait_twi();
    twi_ptr = 130;
    start_twi();
  }
}

void display_init() {
  init_twi();
  twi_buf[26] = SSD1306_I2C_ADDRESS;
  twi_buf[25] = 0;
  twi_buf[24] = SSD1306_DISPLAYOFF;
  twi_buf[23] = SSD1306_SETDISPLAYCLOCKDIV;
  twi_buf[22] = 0x80;
  twi_buf[21] = SSD1306_SETMULTIPLEX;
  twi_buf[20] = 0x3F;
  twi_buf[19] = SSD1306_SETDISPLAYOFFSET;
  twi_buf[18] = 0x00;
  twi_buf[17] = SSD1306_SETSTARTLINE | 0x00;
  twi_buf[16] = SSD1306_CHARGEPUMP;
#ifdef SSD1306_EXTERNALVCC
  twi_buf[15] = 0x10;
#else
  twi_buf[15] = 0x14;
#endif
  twi_buf[14] = SSD1306_MEMORYMODE;
  twi_buf[13] = 0x00;
  twi_buf[12] = SSD1306_SEGREMAP | 0x01;
  twi_buf[11] = SSD1306_COMSCANDEC;
  twi_buf[10] = SSD1306_SETCOMPINS;
  twi_buf[ 9] = 0x12;
  twi_buf[ 8] = SSD1306_SETCONTRAST;
#ifdef SSD1306_EXTERNALVCC
  twi_buf[ 7] = 0x9F;
#else
  twi_buf[ 7] = 0xCF;
#endif
  twi_buf[ 6] = SSD1306_SETPRECHARGE;
#ifdef SSD1306_EXTERNALVCC
  twi_buf[ 5] = 0x22;
#else
  twi_buf[ 5] = 0xF1;
#endif
  twi_buf[ 4] = SSD1306_SETVCOMDETECT;
  twi_buf[ 3] = 0x40;
  twi_buf[ 2] = SSD1306_DISPLAYALLON_RESUME;
  twi_buf[ 1] = SSD1306_NORMALDISPLAY;
  twi_buf[ 0] = SSD1306_DISPLAYON;
  twi_ptr = 27;
  start_twi();
  display_clear();
}

#if 0

// input d1, output d1%=10, d10=d1/10 (d1 in ragne 0:9)
inline void div10(uint8_t &d1, uint8_t &d10) {
  uint8_t tmp;
  asm volatile (
    // divide by 10 
    "ldi %2, 205" "\n\t"
    "fmul %0, %2" "\n\t"
    "ldi %1, 0xF0" "\n\t"
    "and %1, r1" "\n\t"
    "swap %1" "\n\t"
    "ldi %2, 10" "\n\t"
    "mul %1, %2" "\n\t"
    "sub %0, r0" "\n\t"
    "clr __zero_reg__" "\n\t"
    : "=a" (d1), "=r" (d10), "=a" (tmp)
    : "0" (d1)
  );
  //d10 = (d1*205)>>11;
  //d1 -= d10*10;
}

// input d1, output d1%=10, d10=d1/10%10, d100=d1/100, (d1, d10 in ragne 0:9)
inline void div10(uint8_t &d1, uint8_t &d10, uint8_t &d100) {
  // divide by 100 and 10
  // 0 [0, 255]
  // b0 (val/100) d (val/10%10) a0 (val%10) 23 clk
  uint8_t tmp;
  asm volatile (
    "ldi %2, 41" "\n\t"
    "mul %0, %2" "\n\t"
    "mov %3, r1" "\n\t"
    "andi %3, 0xF0" "\n\t"
    "swap %3" "\n\t"
    "ldi %2, 100" "\n\t"
    "mul %3, %2" "\n\t"
    "sub %0, r0" "\n\t"
    "ldi %2, 205" "\n\t"
    "fmul %0, %2" "\n\t"
    "ldi %1, 0xF0" "\n\t"
    "and %1, r1" "\n\t"
    "swap %1" "\n\t"
    "ldi %2, 10" "\n\t"
    "mul %1, %2" "\n\t"
    "sub %0, r0" "\n\t"
    "clr __zero_reg__" "\n\t"
    : "=a"(d1), "=a"(d10), "=a"(tmp), "=a"(d100)
    : "0"(d1)
  );
  /*d10 = (d1*205)>>11;
  d100 = (d1*41)>>12;
  d1 -= d10*10;
  d10 -= d100*10;*/
}
// input val (range 0-1023), output s=val%10, d=val/10%10, h=val/100
//inline void div10(uint16_t val, uint8_t &s, uint8_t &d, uint8_t &h) {
inline void div100(uint16_t& val, uint8_t &d) {
  // divide by 100 and 10
  // b0:a0 [0, 999]
  // b0 (val/100) d (val/10%10) a0 (val%10) 23 clk
  uint8_t tmp;
  asm volatile (
    "ldi %2, 41" "\n\t"
    "mul %B0, %2" "\n\t"
    "mov %B0, r0" "\n\t"
    "mul %A0, %2" "\n\t"
    "add %B0, r1" "\n\t"
    "andi %B0, 0xF0" "\n\t"
    "swap %B0" "\n\t"
    "ldi %2, 100" "\n\t"
    "mul %B0, %2" "\n\t"
    "sub %A0, r0" "\n\t"
    "ldi %2, 205" "\n\t"
    "fmul %A0, %2" "\n\t"
    "ldi %1, 0xF0" "\n\t"
    "and %1, r1" "\n\t"
    "swap %1" "\n\t"
    "ldi %2, 10" "\n\t"
    "mul %1, %2" "\n\t"
    "sub %A0, r0" "\n\t"
    "clr __zero_reg__" "\n\t"
    : "=a"(val), "=a"(d), "=a"(tmp)
    : "0"(val)
  );
}

inline void div1000(uint16_t& val, uint8_t& r) {
  // divide by 1000: approximate with 1024
  // b0:a0 [0, 65535]
  // b0:a0 (val%1000), $1 (val/1000); 13-19 clk
  uint8_t tmp;
  asm volatile (
    "mov %1, %B0" "\n\t"
    "lsr %1" "\n\t"
    "lsr %1" "\n\t"
    "andi %B0, 0x03" "\n\t"
    "ldi %2, 24" "\n\t"
    "mul %1, %2" "\n\t"
    "add %A0, r0" "\n\t"
    "adc %B0, r1" "\n\t"
    "ldi %2, hi8(1000)" "\n\t"
    "cpi  %A0, lo8(1000)" "\n\t"
    "cpc  %B0, %2" "\n\t"
    "brmi done_%=" "\n\t"
    "subi %1, -2" "\n\t"
    "subi %A0, lo8(2000)" "\n\t"
    "sbci %B0, hi8(2000)" "\n\t"
    "brpl done_%=" "\n\t"
    "subi %1, 1" "\n\t"
    "subi %A0, lo8(-1000)" "\n\t"
    "sbci %B0, hi8(-1000)" "\n\t"
    "done_%=:" "\n\t"
    "clr __zero_reg__" "\n\t"
    : "=a" (val), "=a"(r), "=a"(tmp)
    : "0" (val)
  );
}

#endif

volatile uint8_t* getChar(volatile uint8_t* ptr, uint8_t c) {
  *(--ptr) = 0;
  *(--ptr) = pgm_read_byte(&Font8x5[c]);
  *(--ptr) = pgm_read_byte(&Font8x5[c+256]);
  *(--ptr) = pgm_read_byte(&Font8x5[c+512]);
  *(--ptr) = pgm_read_byte(&Font8x5[c+768]);
  *(--ptr) = pgm_read_byte(&Font8x5[c+1024]);
  return ptr;
}

template<int p, int d>
struct getCharIF {
    static inline volatile uint8_t* get(volatile uint8_t* ptr, uint8_t c) { return ptr; }
};
template<int p>
struct getCharIF<p, p> {
  static inline volatile uint8_t* get(volatile uint8_t* ptr, uint8_t c) {
    *(--ptr) = 0;
    *(--ptr) = pgm_read_byte(&Font8x5[c]);
    *(--ptr) = pgm_read_byte(&Font8x5[c+256]);
    *(--ptr) = pgm_read_byte(&Font8x5[c+512]);
    *(--ptr) = pgm_read_byte(&Font8x5[c+768]);
    *(--ptr) = pgm_read_byte(&Font8x5[c+1024]);
    return ptr;
  }
};

#if 0
void display_uint8(uint8_t x, uint8_t y, uint8_t val) {
  display_pos(x, y);
  uint8_t lbuf[3];
  lbuf[2] = val;
  div10(lbuf[2], lbuf[1], lbuf[0]);
  if (lbuf[0] == 0) {
    lbuf[0] = 240;
    if (lbuf[1] == 0) {
      lbuf[1] = 240;
    }
  }
  wait_twi();
  volatile uint8_t* ptr = &twi_buf[20];
  *(--ptr) = SSD1306_I2C_ADDRESS;
  *(--ptr) = 0x40;
  ptr = getChar(ptr, lbuf[0] + 0x30);
  ptr = getChar(ptr, lbuf[1] + 0x30);
  ptr =getChar(ptr, lbuf[2] + 0x30);
  twi_ptr = 20;
  start_twi();
}

template<int dot=1, int sign=1, int digits=5>
void display_fp16(uint8_t x, uint8_t y, int16_t val) {
  display_pos(x, y);
  wait_twi();
  uint8_t lbuf[3];
  volatile uint8_t* ptr = &twi_buf[2 + (dot?6:0) + sign*6 + digits*6];
  *(--ptr) = SSD1306_I2C_ADDRESS;
  *(--ptr) = 0x40;
  if (sign) {
    if (val >= 0) {
      ptr = getChar(ptr, '+');
    } else {
      ptr = getChar(ptr, '-');
      val = -val;
    }
  }
  if (digits > 3) {
    div1000(reinterpret_cast<uint16_t&>(val), lbuf[1]);
  }
  if (digits > 4) {
      div10(lbuf[1], lbuf[0]);
  }
  div100(reinterpret_cast<uint16_t&>(val), lbuf[2]);
  if (digits<5 || (lbuf[0] == 0 && dot<10000)) {
    if (digits>4) lbuf[0] = 240;
    if (digits<4 || (lbuf[1] == 0 && dot<1000)) {
      if (digits>3) lbuf[1] = 240;
      if (unpack<1>(val) == 0 && dot<100) {
        set<1>(val, 240);
        if (lbuf[2] == 0 && dot<10) {
          lbuf[2] = 240;
        }
      }
    }
  }
  if (digits > 4) {
    ptr = getChar(ptr, lbuf[0]+0x30);
    ptr = getCharIF<dot,10000>::get(ptr,'.');
  }
  if (digits > 3) {
    ptr = getChar(ptr, lbuf[1]+0x30);
    ptr = getCharIF<dot,1000>::get(ptr,'.');
  }
  ptr = getChar(ptr, unpack<1>(val)+0x30);
  ptr = getCharIF<dot,100>::get(ptr,'.');
  ptr = getChar(ptr, lbuf[2]+0x30);
  ptr = getCharIF<dot,10>::get(ptr,'.');
  ptr = getChar(ptr, unpack<0>(val)+0x30);
  ptr = getCharIF<dot,1>::get(ptr,'.');
  twi_ptr = 2 + (dot?6:0) + sign*6 + digits*6;
  start_twi();
}
template<int dot=1, int sign=1, int digits=3>
void display_fp8(uint8_t x, uint8_t y, int8_t val) {
  display_pos(x, y);
  wait_twi();
  uint8_t lbuf[3];
  volatile uint8_t* ptr = &twi_buf[2 + (dot?6:0) + sign*6 + digits*6];
  *(--ptr) = SSD1306_I2C_ADDRESS;
  *(--ptr) = 0x40;
  if (sign) {
    if (val >= 0) {
      ptr = getChar(ptr, '+');
    } else {
      ptr = getChar(ptr, '-');
      val = -val;
    }
  }
  lbuf[2] = val;
  if (digits == 3) {
    div10(lbuf[2], lbuf[1], lbuf[0]);
  } else {
    div10(lbuf[2], lbuf[1]);
  }
  if (digits<3 || (lbuf[0] == 0 && dot<100)) {
    if (digits>2) lbuf[0] = 240;
    if (lbuf[1] == 0 && dot<10) {
      lbuf[1] = 240;
    }
  }
  if (digits > 2) {
    ptr = getChar(ptr, lbuf[0]+0x30);
    ptr = getCharIF<dot,100>::get(ptr,'.');
  }
  ptr = getChar(ptr, lbuf[1] + 0x30);
  ptr = getCharIF<dot,10>::get(ptr,'.');
  ptr = getChar(ptr, lbuf[2] + 0x30);
  ptr = getCharIF<dot,1>::get(ptr,'.');
  twi_ptr = 2 + (dot?6:0) + sign*6 + digits*6;
  start_twi();
}

#endif

void display_print(uint8_t x, uint8_t y, const char *str PROGMEM, uint8_t len) {
  display_pos(x, y);
  wait_twi();
  uint8_t idx = len*6;
  twi_ptr = idx + 2;
  volatile uint8_t* ptr = &twi_buf[idx + 2];
  *(--ptr) = SSD1306_I2C_ADDRESS;
  *(--ptr) = 0x40;
  do {
    uint8_t cval = pgm_read_byte(str++);
    ptr = getChar(ptr, cval);
    idx -= 6;
  } while(idx);
  start_twi();
}
